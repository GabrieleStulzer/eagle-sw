## main/Kconfig.projbuild
```kconfig
menu "EagleSW Configuration"

    orsource "$IDF_PATH/examples/common_components/env_caps/$IDF_TARGET/Kconfig.env_caps"

    config GREEN_LED_GPIO
        int "Green Led GPIO number"
        range ENV_GPIO_RANGE_MIN ENV_GPIO_OUT_RANGE_MAX
        default 17
        help
            GPIO number of green led.

    config RED_LED_GPIO
        int "Red Led GPIO number"
        range ENV_GPIO_RANGE_MIN ENV_GPIO_OUT_RANGE_MAX
        default 16
        help
            GPIO number of led for high voltage alert.

    config YELLOW_LED_GPIO
        int "Yyellow Led GPIO number"
        range ENV_GPIO_RANGE_MIN ENV_GPIO_OUT_RANGE_MAX
        default 17
        help
            GPIO number of led for low voltage aler.

    config BUTTON_GPIO
        int "Button GPIO Number"
        range ENV_GPIO_RANGE_MIN ENV_GPIO_OUT_RANGE_MAX
        default 32 
        help
            GPIO number of Emergency button sensor.

    config VOLTAGE_ADC
        int "Voltage ADC Channel"
        default 6 
        help
            Voltage ADC Channel number (not GPIO).

    config SENSOR_ADC
        int "Sensor ADC Channel"
        default 7 
        help
            Sensor ADC Channel number (not GPIO).

endmenu
```
